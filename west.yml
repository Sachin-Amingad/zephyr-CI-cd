## west.yml
```yaml
manifest:
  defaults:
    remote: zephyrproject-rtos
    revision: v3.6.0
  remotes:
    - name: zephyrproject-rtos
      url-base: https://github.com/zephyrproject-rtos
  projects:
    - name: zephyr
      import: true
  self:
    path: zephyr-CI-cd
```
